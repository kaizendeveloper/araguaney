;//////////////////////////////////////////////////////////////////////////////////

;      ___      __      ___      ___               ___             ____
;    /     \  /    \  /     \  /     \  |     |  /     \  |\   |  |      \     /
;    |     |  |    |  |     |  |        |     |  |     |  | \  |  |       \   /
;    |_____|  |___/   |_____|  |    __  |     |  |_____|  |  \ |  |__      \ /
;    |     |  |   \   |     |  |     |  |     |  |     |  |   \|  |         |
;    |     |  |    \  |     |  \_____/  \_____/  |     |  |    \  |____     |


;							KERNEL MULTITAREA COOPERATIVA
;								  PARA EL PIC16F877A
;								    VERSION 1.0.0
;						POR: MIGUEL, DELLI CARPINI






	LIST P=16F877a


#INCLUDE <P16F877A.INC>

 __CONFIG _DEBUG_OFF & _LVP_OFF & _WRT_HALF &_CP_OFF & _BODEN_OFF & _PWRTE_ON & _WDT_OFF & _HS_OSC 


;*******************************************************

;		IGUALDADES

;*******************************************************

;BANDERAS DE TEMPORIZADORES (B_TEMPORIZADOR)
	
	TIPO_BUSQUEDA_TEMPORIZADOR EQU 0 	;SI SE ESTABLECE A "0" ANTES DE LLAMAR AL SERVICIO
										;BUSCAR TEMPORIZADOR BUSCARA UN TEMPORIZADOR LIBRE
										;Y SI SE ESTABLECE A "1" BUSCARA UNO EN USO

	TEMPORIZADOR_ENCONTRADO EQU 1	;ES "1" CUANDO SE HALLA UN TEMPORIZADOR LIBRE EN EL BLOQUE
									;DE TEMPORIZACION
	
	LIMITE_BLOQUE EQU 2			;ES "1" CUANDO EL PUNTERO AL BLOQUE LLEGO A SU LIMITE FISICO
									;ES "0" CUANDO NO SE LLEGÓ
	
	TIPO_TEMPORIZADOR EQU 7
	;DEFINE EL TIPO DE TEMPORIZADOR A ESTABLECER, ES USADO A LA HORA DE DECLARAR UN TEMPORIZADOR

	;TIPO_TEMPORIZADOR = "1" --> EL TEMPORIZADOR SERÁ DE CARRERA LIBRE
	;							 (NO BLOQUEARA A LA TAREA QUE LO LLAMA)
	;TIPO_TEMPORIZADOR = "0" --> EL TEMPORIZADOR SERÁ BLOQUEANTE
	;							 (DEMORARÁ A LA TAREA QUE LO LLAMA, BLOQUEA)
	
;IGUALDADES REFERENTES A TEMPORIZADORES NO BLOQUEANTES (NO PERTENECEN A NINGUNA BANDERA)
; ESTAS SON USADAS POR LA MACRO DEL SISTEMA ARAGUANEY
	TEMPORIZADOR_NB_EXPIRO EQU 1
	TEMPORIZADOR_NB_NO_ENCONTRADO EQU 2
	TEMPORIZADOR_NB_EN_CONTEO EQU 3






;DEFINICION DE LOS ESTADOS DE UNA TAREA (IGUALDADES DEL SISTEMA)
	ELEGIBLE EQU 0
	CORRIENDO EQU 2
	DEMORADA EQU 3
	ESPERANDO_POR_TEMPORIZADOR EQU 4
	SUSPENDIDA EQU 5



;******************************************************
;		VARIABLES DEL KERNEL MULTITAREA
;******************************************************
	CBLOCK 0x20


;NOTA: LAS VARIABLES INTERNAS DE CADA TAREA DEBEN DECLARARSE APARTE, NO EN ESTA SECCION.
;SE PUEDE SUSTITUIR:

; 				TAREA#_CONTEXTO_ALTO EN ENCIENDE_LEDS_ALTO
;				TAREA#_CONTEXTO_BAJO EN ENCIENDE_LEDS_BAJO

; SE DIFERENCIA EL ALTO DEL BAJO PARA PERMITIR LA CAPACIDAD AL PIC DE EJECUTAR CODIGO EN
; CUALQUIER PAGINA DE MEMORIA ROM. LOS NOMBRES QUE SE MUESTRAN AQUI SON REFERENCIALES, LOS
; UNICOS QUE NO SE DEBEN CAMBIAR SON LOS PUNTERO_TAREA_P#.

; AHORA LAS PRIORIDADES SON DINAMICAS!!!
;>>>>>>>>>>>>>>>>>>>>>>>>>>>>>>>>>>>>>>>>>>>>>>>>>>>
;BLOQUE DE CONTROL DE TAREAS (BCT DE AQUI EN ADELANTE)
;>>>>>>>>>>>>>>>>>>>>>>>>>>>>>>>>>>>>>>>>>>>>>>>>>>>
		;LED_GIRATORIOS
		LED_GIRATORIOS_PRIORIDAD	;PRIORIDAD DE LA TAREA
		LED_GIRATORIOS_ESTADO		;ESTADO DE LA TAREA
		LED_GIRATORIOS_CONTEXTO_ALTO;BYTE ALTO CON EL VALOR DEL PC
		LED_GIRATORIOS_CONTEXTO_BAJO;BYTE BAJO CON EL VALOR DEL PC
		
		
		;TONO_1
		TONO_1_PRIORIDAD	;PRIORIDAD DE LA TAREA
		TONO_1_ESTADO		;ESTADO DE LA TAREA
		TONO_1_CONTEXTO_ALTO;BYTE ALTO CON EL VALOR DEL PC
		TONO_1_CONTEXTO_BAJO;BYTE BAJO CON EL VALOR DEL PC		
		
		;TONO_2
		TONO_2_PRIORIDAD	;PRIORIDAD DE LA TAREA
		TONO_2_ESTADO		;ESTADO DE LA TAREA
		TONO_2_CONTEXTO_ALTO;BYTE ALTO CON EL VALOR DEL PC
		TONO_2_CONTEXTO_BAJO;BYTE BAJO CON EL VALOR DEL PC

		;TONO_3
		TONO_3_PRIORIDAD	;PRIORIDAD DE LA TAREA
		TONO_3_ESTADO		;ESTADO DE LA TAREA
		TONO_3_CONTEXTO_ALTO;BYTE ALTO CON EL VALOR DEL PC
		TONO_3_CONTEXTO_BAJO;BYTE BAJO CON EL VALOR DEL PC

		
		PUNTERO_DE_SUPERBLOQUE 		;PUNTERO AL PROXIMO BCT ANALIZAR
		PRINCIPIO_TAREA_ANTERIOR	;APUNTA AL BCT QUE SE LA HA CEDIDO EL CPU
;VARIABLES DEL PLANIFICADOR

		CONTADOR_DE_BLOQUE		;CUENTA CUANTOS BLOQUES DE CONTROL DE TAREAS SE HAN ESCANEADO

		PRIORIDAD_A_CORRER		;CONTIENE LA PRIORIDAD A BUSCAR DENTRO DEL SUPERBLOQUE DE TAREAS
		
		CONTADOR_LIBRE			;ES UN CONTADOR DE CARRERA LIBRE, ES DECIR QUE SU VALOR VA
								;INCREMENTANDO EN CADA LLAMADA AL PLANIFICADOR Y FUNGE
								;COMO MECANISMO PARA ELEGIR QUE PRIORIDAD LE TOCA CORRER
		CONTADOR_LIBRE_COPIA	;ES UNA INSTANCIA DEL CONTADOR DE CARRERA LIBRE, PARA RESTAURAR EL
								;VALOR DE (CONTADOR_LIBRE) DESPUES DEL PROCESO DE ELECCION
								;DE PRIORIDAD


;VARIABLES DE PROPOSITO GENERAL
	GENERAL

	ENDC


;VARIABLES USADAS POR LAS TAREAS
	CBLOCK GENERAL + 1
		LED_GIRATORIOS_CONTADOR
	ENDC





	;PUNTERO_DE_PILA EQU 0x1A0 ;PUNTERO A MEMORIA EN EL BANCO 3, FUNCIONA COMO EL STACK PERO DE LOS
							;VALORES DE FSR AL RESPALDAR PARA ATENDER UNA RUTINA DE INTERRUPCION

	;SE USA EL BANCO 3 DE MEMORIA DE DATOS PARA RESPALDAR EL ACUMULADOR, EL FSR Y LA BANDERA
	;DE STATUS ANTES DE EJECUTAR EL SERVICIO A UNA INTERRUPCION



;VARIABLES DE RESPALDO AL CAMBIAR CONTEXTOS (POR PLANIFICADOR O INTERRUPCION)

;ESTAS VARIABLES FUERN COLOCADAS AQUI DEBIDO A QUE SON ACCESIBLES
;DESDE CUALQUIER PAGINA DE DIRECCIONAMIENTO, LO QUE EVITA LOS ENGORROSOS CAMBIOS DE BANCO
	CBLOCK 0x70
		W_INT				;RESPALDO DEL ACUMULADOR (CAPA DE INTERRUPCION)
		FSR_INT				;RESPALDO DEL FSR (CAPA DE INTERRUPCION)
		STATUS_INT			;RESPALDO DEL STATUS (CAPA DE INTERRUPCION)
		W_TEMPORAL			;RESPALDO DEL ACUMULADOR (CAPA DE APLICACION)
		FSR_TEMPORAL		;RESPALDO DEL FSR (CAPA DE APLICACION)
		STATUS_TEMPORAL		;RESPALDO DEL STATUS (CAPA DE APLICACION)
		RESPALDO_PCH			;RESPALDO DE LA PARTE ALTA DEL CONTADOR DE PROGRAMA
								;USADO DEBIDO QUE AL OCURRIR UNA INTERRUPCION SE MODIFICA EL PCLATH
								;ASI NO ALTERAMOS EL CURSO NATURAL DE LAS TAREAS
	ENDC



;>>>>>>>>>>>>>>>>>>>>>>>>>>>>>>>>>>>>>>>>>>>>>>>>>>>
;		BLOQUE DE TEMPORIZADORES 
;>>>>>>>>>>>>>>>>>>>>>>>>>>>>>>>>>>>>>>>>>>>>>>>>>>>

;EL SUPER BLOQUE DE TEMPORIZADORES ESTA UBICADO EN EL BANCO 1
;ESTE CONTIENE LOS BLOQUES DE TEMPORIZACION

	CBLOCK 0xA0

	TICK_8BIT_TMP		;VARIABLES USADAS PARA COPIAR SUS VALORES DENTRO DE CADA BLOQUE
	TICK_16BIT_TMP		;DE TEMPORIZACION, PUEDEN SER USADAS COMO VARIABLES DE PROPOSITO GENERAL
	TICK_24BIT_TMP		;SIEMPRE Y CUANDO NUNCA SE INVOQUE A UN SERVICIO DEL SISTEMA, YA QUE ESTOS
	TICK_32BIT_TMP		;MODIFICARIAN LOS VALORES

	;LAS SIGUIENTES VARIABLES NO SE DEBEN ACCEDER DE MANERA DIRECTA YA QUE CONTIENE
	;CADA TEMPORIZADOR

	ESTADOTEMP1			;VARIABLES TEMPORIZADOR 1
	TICK_8BIT_1
	TICK_16BIT_1
	TICK_24BIT_1
	TICK_32BIT_1

	ESTADOTEMP2			;VARIABLES TEMPORIZADOR 2
	TICK_8BIT_2
	TICK_16BIT_2
	TICK_24BIT_2
	TICK_32BIT_2

	ESTADOTEMP3			;VARIABLES TEMPORIZADOR 3
	TICK_8BIT_3
	TICK_16BIT_3
	TICK_24BIT_3
	TICK_32BIT_3

	ESTADOTEMP4			;VARIABLES TEMPORIZADOR 4
	TICK_8BIT_4
	TICK_16BIT_4
	TICK_24BIT_4
	TICK_32BIT_4



	PUNTERO_TEMPORIZADORES	;ACTUA COMO PUNTERO DEL SUPERBLOQUE DE TEMPORIZACION
	B_TEMPORIZADOR			;BANDERA DE LOS TEMPORIZADORES (BANDERA DEL SISTEMA)

	GENERAL_TEMP			;VARIABLE DE USO GENERAL UBICADA EN EL MISMO BANCO QUE LOS
							;TEMPORIZADORES, ESTA VARIABLE LA USAN LOS SERVICIOS DEL SISTEMA
							;PARA ALMACENAR LA LLAVE DE LOS TEMPORIZADORES NO BLOQUEANTES
	GENERAL_TEMP_INT		;
	ENDC

;-----------------------------------------------------------------------------------------
; 						SECCION DE MACROS DEL KERNEL
;-----------------------------------------------------------------------------------------

;EN ESTE ARCHIVO SE ENCUENTRAN LAS MACROS NECESARIAS PARA EL FUNCIONAMIENTO DEL KERNEL
;SE HAN COLOCADO EN UN ARCHIVO APARTE PARA DESPEJAR VISUALMENTE ESTE ENTORNO DE DESARROLLO

INCLUDE <ARMACROS.ASM>

;NOTA: SE PUEDE INCLUIR EN ESTE ARCHIVO LAS MACROS HECHAS POR EL USUARIO


;---------------------------------------------------------------------------------------
;DEFINICIONES ESPECIFICAS DEL SISTEMA
;---------------------------------------------------------------------------------------

#DEFINE APAGA_INTS BCF INTCON,GIE	;INTERRUPCIONES
#DEFINE ACTIVA_INTS BSF INTCON,GIE

;---------------------------------------------------------------------------------------
;DEFINICIONES ESPECIFICAS DE LA APLICACION
;---------------------------------------------------------------------------------------

#DEFINE TECLA_TONO_1 PORTD,2	;TECLA GENERADORA DEL TONO 1
#DEFINE TECLA_TONO_2 PORTD,3	;TECLA GENERADORA DEL TONO 2
#DEFINE TECLA_TONO_3 PORTC,4	;TECLA GENERADORA DEL TONO 3
#DEFINE PIN_SONIDO PORTC,5	;SALIDA DE AUDIO




;****************************************************************************************


;						INICIO DE CODIGO EJECUTABLE


;****************************************************************************************
	ORG 0				;VECTOR DE RESET
	GOTO INICIO
	ORG 4				;VECTOR DE INTERRUPCION		
	BCF INTCON,GIE		;DESHABILITAR INTERRUPCIONES

	MOVWF W_INT			;GUARDAR EL CONTEXTO DE LA CAPA DE APLICACION
	SWAPF STATUS,W
	MOVWF STATUS_INT
	SWAPF FSR,W
	MOVWF FSR_INT
	
	
	MOVF PCLATH,W		;SALVAR EL PCLATH
	MOVWF RESPALDO_PCH	
	MOVLW HIGH(RSI)		;COLOCAR EN PCLATH LA DIRECCION ALTA DE LA MEMORIA DE PROGRAMA
	MOVWF PCLATH		;CORRESPONDIENTE A LA RUTINA DE SERVICIO DE INTERRUPCIÓN
	GOTO RSI			;RUTINA SERVICIO DE INTERRUPCION


;****************************************************************************************
;									VECTOR DE RESET
;****************************************************************************************


INICIO

;LIMPIEZA DE LA RAM (BANCO 1)
;(DONDE RESIDE EL SUPER BLOQUE DE TEMPORIZADORES)
;SE DEBE LIMPIAR PARA QUE AL RESETEARSE EL PIC NO HAYA VALORES ALEATORIOS QUE HAGAN CREER AL
;KERNEL QUE ESTAN OCUPADOS LOS TEMPORIZADORES Y PUEDAN SER ASIGNADOS A LAS TAREAS.

;SECCION DE CODIGO DE LIMPIEZA DE RAM MEJORADO POR:
;	Raúl Mendiberry

	MOVLW 0xA0		;PRINCIPIO DEL BANCO 1 PARA REGISTRO DE PROPOSITO GENERALES
	MOVWF FSR		;APUNTAR INDIRECTAMENTE
LIMPIAR_BANCO_1
	CLRF INDF 		;LIMPIAR LA VARIABLE
	INCF FSR,F		;APUNTAMOS A LA SIGUIENTE VARIABLE PARA SU POSTERIOR LIMPIEZA
	MOVLW 0xF0		;COMPARAR SI SE LLEGO AL FINAL DEL BANCO 1 (GPR)
	SUBWF FSR,W
	BTFSC STATUS,Z	
	GOTO $+2		;SE TERMINO LA LIMPIEZA
	GOTO LIMPIAR_BANCO_1	;LIMPIAR SIGUIENTE





;--------------------------------------------------------------------------------------------
;					INICIALIZACION DE TAREAS
;--------------------------------------------------------------------------------------------

;EN ESTA SECCION SE DEBEN CREAR LAS CONSTANTES DEL ENSAMBLADOR QUE CONTIENEN EL PRINCIPIO
;Y EL FIN DE LAS VARIABLES USADAS POR EL PLANIFICADOR



;INICIALIZE LAS CONSTANTES DEL ENSAMBLADOR PARA QUE EL KERNEL SEPA EL PRINCIPIO Y
;FINAL DE LAS TAREAS.


;EL INICIO DEL SUPERBLOQUE DE TAREAS SE CONOCE YA (0x20) YA QUE ESTA DESTINADO QUE EL BANCO 0
;CONTENGA LOS BLOQUES DE CONTROL DE LAS TAREAS
INICIO_DIRECCION_P1 SET 0x20
;EL FIN DEL SUPERBLOQUE ES SU PUNTERO, DE ESTA MANERA PODEMOS AUTOMATICAMENTE GENERAR LOS VALORES
FIN_DIRECCION_P1 SET PUNTERO_DE_SUPERBLOQUE

;EL MAXIMO DE ESCANEOS PARA GARANTIZAR QUE SE ESCANEE EL BLOQUE DE FORMA CIRCULAR
MAXIMO_ESCANEOS SET ((FIN_DIRECCION_P1 - INICIO_DIRECCION_P1)/4)+1

MAXIMO_PRIORIDADES SET 2	;NUMERO DE PRIORIDADES A USAR EN ESTA APLICACION

;-------------------------------
;INICIALIZACION DEL TEMPORIZADOR

;AQUI LA COSA CAMBIA UN POCO, EL PRINCIPIO DEL SUPERBLOQUE DE TEMPORIZADORES DEBE SER LA PRIMERA
;VARIABLE DE TEMPORIZACION
;NOTA: (NO SE DEBE TOMAR EN CUENTA LAS VARIABLES TEMPORALES QUE SE USAN SOLO PARA COPIAR VALORES 
; A UN BLOQUE, SINO LA PRIMERA VARIABLE DE UN BLOQUE DE TEMPORIZACION REAL)

INICIO_BLOQUE_TEMPORIZADOR SET ESTADOTEMP1
;EL FIN DEL BLOQUE ES SU PUNTERO
FIN_BLOQUE_TEMPORIZADOR SET PUNTERO_TEMPORIZADORES


		
;INICIALIZACION
;	MOVLW (PUNTERO_DE_PILA+1)
;	BANKSEL PUNTERO_DE_PILA
;	MOVWF PUNTERO_DE_PILA


;******************************************************************************	
;TEMPORIZADORES

	;ENSEÑAR AL KERNEL EL PRINCIPIO Y EL FIN DEL SUPERBLOQUE DE TEMPORIZACION
	BANKSEL B_TEMPORIZADOR
	MOVLW INICIO_BLOQUE_TEMPORIZADOR
	MOVWF PUNTERO_TEMPORIZADORES


;******************************************************************************
; TAREAS

	;ENSEÑAR AL KERNEL EL PRINCIPIO Y EL FIN DEL SUPERBLOQUE DE TAREAS

	BANKSEL PUNTERO_DE_SUPERBLOQUE
	MOVLW INICIO_DIRECCION_P1	;ALMACENAR VALOR DEL PUNTERO DE INICIO
	MOVWF PUNTERO_DE_SUPERBLOQUE		;ESTA VARIABLE SIRVE COMO RESPALDO DE FSR

;INICIALIZAR TAREA LED_GIRATORIOS
;**********************************
	MOVLW HIGH(LED_GIRATORIOS)			;PARA ESTA TAREA
	MOVWF LED_GIRATORIOS_CONTEXTO_ALTO	;ALMACENAR BYTE ALTO DEL CONTADOR DE PROGRAMA
	MOVLW LOW(LED_GIRATORIOS)
	MOVWF LED_GIRATORIOS_CONTEXTO_BAJO	;ALMACENAR BYTE BAJO DEL CONTADOR DE PROGRAMA
	CLRF LED_GIRATORIOS_ESTADO			;HACERLA DE UNA VEZ ELEGIBLE
	MOVLW 2
	MOVWF LED_GIRATORIOS_PRIORIDAD
;**********************************

;INICIALIZAR TAREA TONO 1
;**********************************
	MOVLW HIGH(TONO_1)			;PARA ESTA TAREA
	MOVWF TONO_1_CONTEXTO_ALTO	;ALMACENAR BYTE ALTO DEL CONTADOR DE PROGRAMA
	MOVLW LOW(TONO_1)
	MOVWF TONO_1_CONTEXTO_BAJO	;ALMACENAR BYTE BAJO DEL CONTADOR DE PROGRAMA
	CLRF TONO_1_ESTADO			;HACERLA DE UNA VEZ ELEGIBLE
	MOVLW 1
	MOVWF TONO_1_PRIORIDAD

;INICIALIZAR TAREA TONO 2
;**********************************
	MOVLW HIGH(TONO_2)			;PARA ESTA TAREA
	MOVWF TONO_2_CONTEXTO_ALTO	;ALMACENAR BYTE ALTO DEL CONTADOR DE PROGRAMA
	MOVLW LOW(TONO_2)
	MOVWF TONO_2_CONTEXTO_BAJO	;ALMACENAR BYTE BAJO DEL CONTADOR DE PROGRAMA
	CLRF TONO_2_ESTADO			;HACERLA DE UNA VEZ ELEGIBLE
	MOVLW 1
	MOVWF TONO_2_PRIORIDAD

;INICIALIZAR TAREA TONO 3
;**********************************
	MOVLW HIGH(TONO_3)			;PARA ESTA TAREA
	MOVWF TONO_3_CONTEXTO_ALTO	;ALMACENAR BYTE ALTO DEL CONTADOR DE PROGRAMA
	MOVLW LOW(TONO_3)
	MOVWF TONO_3_CONTEXTO_BAJO	;ALMACENAR BYTE BAJO DEL CONTADOR DE PROGRAMA
	CLRF TONO_3_ESTADO			;HACERLA DE UNA VEZ ELEGIBLE
	MOVLW 1
	MOVWF TONO_3_PRIORIDAD


;****************************************************************************
;			CONFIGURACION DE PERIFERICOS Y DEMAS OPCIONES ESPECIALES DEL CPU
;****************************************************************************
;CONFIGURE SUS PERIFERICOS, COLOQUE LAS OPCIONES DEL PREESCALADOR A LOS TIMERS
;ESPECIFICAS A LA APLICACION

	BSF STATUS,RP0	;SELECCIONAR BANCO 1

;PREPARANDO LOS DATOS PARA EL REGISTRO OPTION
	MOVLW B'00000001'
	;<7>
	;RBPU: HABILITACION DE PULLUPS EN EL PORTB
	;1 = PULLPUPS DESHABILITADOS
	;0 = PULLPUPS HABILITADOS
	;<6>
	;INTEDG: BIT DE SELECCION DE FLANCO
	;1= INTERRUPCION EN EL FLANCO DE SUBIDA DEL PIN RB0/INT
	;0 = INTERRUPCION EN EL FLANCO DE SUBIDA DEL PIN RB0/INT
	;<5>
	;T0CS: BIT DE SELECCION DE FUENTE DE RELOJ PARA EL TMRO 
	;1 = TRANSICION EN EL PIN RB4/T0CKI
	;0 = RELOJ INTERNO POR CICLO DE INSTRUCCION (CLKO)
	;<4>
	;T0SE: BIT DE SELECCION DE FLANCO TMR0
	;1 = INCREMENTAR EN FLANCO DE BAJADA EN EL PIN RA4/T0CKI
	;0 = INCREMENTAR EN FLANCO DE SUBIDA EN EL PIN RA4/T0CKI
	;<3>
	;PSA: ASIGNACION DEL PREESCALADOR
	;1 = PREESCALADOR ASIGNADO AL PERRO GUARDIAN
	;0 = PREESCALADOR ASIGNADO AL TMR0
	;<2-0>
	;PS2:PS0: TASA DE DIVISION DEL PREESCALADOR
	;BITS	;TMR0		;WDT
	;000	1 : 2		1 : 1
	;001	1 : 4		1 : 2
	;010	1 : 8		1 : 4
	;011	1 : 16		1 : 8
	;100	1 : 32		1 : 16
	;101	1 : 64		1 : 32
	;110	1 : 128		1 : 64
	;111	1 : 256		1 : 128

	MOVWF OPTION_REG	;APLICAR LA CONFIGURACION


	;CONFIGURACION INICIAL DE LAS SALIDAS DE LA APLICACION
	CLRF TRISB		;PUERTO B (DIODOS LED) COMO SALIDA

	;SALIDAS DE LA APLICACION
	BCF PIN_SONIDO

	
	;ENTRADAS DE LA APLICACION

	BSF TECLA_TONO_1	;TECLA GENERADORA DE DO
	BSF TECLA_TONO_2	;TECLA GENERADORA DE MI
	BSF TECLA_TONO_3	;TECLA GENERADORA DE SOL

	BCF STATUS,RP0	;SELECCIONAR BANCO 0


	MOVLW 0xFF
	MOVWF PORTB		;APAGAR LOS LEDS

	CLRF TMR0

	BSF INTCON,GIE	;HABILITAR TODAS LAS INTERRUPCIONES
	BSF INTCON,TMR0IE ;HABILITAR INTERRUPCIONES POR DESBORDAMIENTO DEL TMR0


;************************************************************************************

;							******** PLANIFICADOR ********

;************************************************************************************

;ESTA PARTE DEL KERNEL SE ENCARGA DE ELEGIR A QUE TAREA SE LE DARA EL CONTROL DEL CPU
;ESTE SE BASA EN PRIORIDADES, OTORGANDOLE MAS OPORTUNIDADES DE OBTENER EL
;CPU A AQUELLAS TAREAS QUE TENGAN MAS PRIORIDAD, ESTE ESTA DIVIDIDO EN TRES PARTES:
;
;	ELECTOR DE PRIORIDAD
;			|---DESPACHADOR
;					|---CAMBIADOR DE CONTEXTOS

#INCLUDE <PLANIFICADOR.ASM>



;************************************************************************************

;						SERVICIOS DEL SISTEMA

;************************************************************************************
#INCLUDE <SERVICIOS.ASM>





;************************************************************************************

;								******* TAREAS *******

;************************************************************************************


;*************************************
;	LED GIRATORIOS
;

;CREA EL EFECTO VISUAL DE ROTACIÓN EN LOS 8 LED CONECTADOS AL PORTB

LED_GIRATORIOS
	CLRF LED_GIRATORIOS_CONTADOR ;INICIALIZAR EL CONTADOR USADO PARA LEER POR TABLA
LED_GIRATORIOS_ROTAR_SIEMPRE
	INCF LED_GIRATORIOS_CONTADOR,F ;INCREMENTAR CONTADOR
	MOVF LED_GIRATORIOS_CONTADOR,W ;¿EL CONTADOR LLEGO A 5?
	XORLW .5
	BZ LED_GIRATORIOS			;SI, EMPEZAR DE NUEVO
	MOVLW HIGH(LED_GIRATORIOS_TABLA) ;NO, LEER LA TABLA PARA DEVOLVER UN VALOR A TRAVES DEL PUERTO
	MOVWF PCLATH                    ;NOS ASEGURAMOS QUE SE ESTE APUNTANDO BIEN A LA TABLA
	MOVF LED_GIRATORIOS_CONTADOR,W
	CALL LED_GIRATORIOS_TABLA
	MOVWF PORTB				 ;EL VALOR ARROJADO POR LA TABLA MOSTRARLA EN LOS LEDS
	DEMORA .1865			;ESPERAR 1865 TICKS (LA TAREA SE BLOQUEARA)
	GOTO LED_GIRATORIOS_ROTAR_SIEMPRE ;HACER UN CICLO MÁS
LED_GIRATORIOS_TABLA
	ADDWF PCL
	NOP
	RETLW B'11101110'
	RETLW B'01110111'
	RETLW B'10111011'
	RETLW B'11011101'
	RETLW 0				;POR PRECAUCION
	RETLW 0
	RETLW 0	


;*************************************
;	TONOS
;

;CAMBIA EL ESTADO DE EL PIN DE SONIDO (PORTC<5>) MIENTRAS LA TECLA ASIGNADA ESTE PRESIONADA


TONO_1
	NOP
	BANKSEL CONTADOR_LIBRE  ;SELECCIONAR BANCO 0
	BTFSS TECLA_TONO_1	;TECLA DEL TONO 1 ¿ESTA PRESIONADA?
	GOTO $+2			;GENERAR EL TONO
	GOTO NO_GENERAR_TONO_1  ;NO, NO GENERAR EL TONO
	BANKSEL CONTADOR_LIBRE  
	BSF PIN_SONIDO	;CAMBIAR EL ESTADO A ALTO
	DEMORA .8		;ESPERAR 8 TICKS
	BCF PIN_SONIDO	;CAMBIA EL ESTADO A BAJO
	DEMORA .8		;ESPERAR 8 TICKS
	GOTO TONO_1		;FIN DE LA TAREA
NO_GENERAR_TONO_1
	ENTREGA_CPU
	GOTO TONO_1

TONO_2
	NOP
	BANKSEL CONTADOR_LIBRE
	BTFSS TECLA_TONO_2	;TECLA DEL TONO 2
	GOTO $+2
	GOTO NO_GENERAR_TONO_2
	BSF PIN_SONIDO
	DEMORA .5		;7
	BCF PIN_SONIDO
	DEMORA .5		;6
	GOTO TONO_2
NO_GENERAR_TONO_2
	ENTREGA_CPU
	GOTO TONO_2

TONO_3
	NOP
	BANKSEL CONTADOR_LIBRE
	BTFSS TECLA_TONO_3	;TECLA DO_1
	GOTO $+2
	GOTO NO_GENERAR_TONO_3
	BSF PIN_SONIDO
	DEMORA .3	    ;5
	BCF PIN_SONIDO
	DEMORA .4		;5
	GOTO TONO_3
NO_GENERAR_TONO_3
	ENTREGA_CPU
	GOTO TONO_3



	
	



	
;***********************************************************************************

;						RUTINA DE SERVICIO DE INTERRUPCIONES
	
;***********************************************************************************
RSI
	;***** NOTA: SOLO SE DEBE ATENDER UNA INTERRUPCION A LA VEZ *****
	;VERIFICAR SI LA INTERRUPCIÓN LA PROVOCÓ EL DESBORDAMIENTO DE TMR0

	BTFSS INTCON,TMR0IF ;SI SE DESBORDÓ EL REGISTRO TMR0, ACUDIR A LA RUTINA DE SERVICIO TIMER
	GOTO SALIDA_INTERRUPCION
	#INCLUDE <TEMPORIZADOR.ASM> 

SALIDA_INTERRUPCION
		
	MOVF RESPALDO_PCH,W		;RESTABLECER EL PCLATH PARA QUE NO SE CORROMPA EL FLUJO DE LA MULTITAREA
	MOVWF PCLATH

	SWAPF FSR_INT,W
	MOVWF FSR
	
	SWAPF STATUS_INT,W
	MOVWF STATUS
	
	MOVF W_INT,W

		
	RETFIE			 ;RETORNAR DESDE INTERRUPCION

	END
